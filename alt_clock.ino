#include <SPI.h>
#include <Wire.h>
#include <Adafruit_GFX.h>
#include <Adafruit_SSD1306.h>
#include "RTClib.h"


#define SCREEN_WIDTH 128  // OLED display width, in pixels
#define SCREEN_HEIGHT 32  // OLED display height, in pixels

// Declaration for an SSD1306 display connected to I2C (SDA, SCL pins)
#define OLED_RESET -1  // Reset pin # (or -1 if sharing Arduino reset pin)
Adafruit_SSD1306 display(SCREEN_WIDTH, SCREEN_HEIGHT, &Wire, OLED_RESET);

const int speakerPin = 25;

RTC_DS3231 rtc;

char Week_days[7][12] = { "Sun", "Mon", "Tue", "Wed", "Thu", "Fri", "Sat" };

void TCA9548A(uint8_t bus) {
  Wire.beginTransmission(0x70);  // TCA9548A address
  Wire.write(1 << bus);          // send byte to select bus
  Wire.endTransmission();
}

// '0', 32x114px
const unsigned char epd_bitmap_0[] PROGMEM = {
  0x01, 0xff, 0xff, 0xfc, 0x01, 0xff, 0xff, 0xfc, 0x03, 0xff, 0xff, 0xfc, 0x03, 0xff, 0xff, 0xf8,
  0x03, 0xff, 0xff, 0xf8, 0x00, 0x00, 0x00, 0x00, 0x00, 0x00, 0x00, 0x00, 0x00, 0x00, 0x00, 0x00,
  0x00, 0x00, 0x00, 0x00, 0x00, 0x00, 0x00, 0x00, 0x00, 0x00, 0x00, 0x00, 0x00, 0x00, 0x00, 0x00,
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  0xff, 0xff, 0xff, 0x80, 0xff, 0xff, 0xff, 0x80
};
// '1', 32x114px
const unsigned char epd_bitmap_1[] PROGMEM = {
  0x00, 0x1f, 0xff, 0xc1, 0x00, 0x1f, 0xff, 0xc1, 0x00, 0x3f, 0xff, 0xc3, 0x00, 0x3f, 0xff, 0x83,
  0x00, 0x3f, 0xff, 0x87, 0x00, 0x00, 0x00, 0x00, 0x00, 0x00, 0x00, 0x00, 0x00, 0x00, 0x00, 0x00,
  0x00, 0x00, 0x00, 0x00, 0x00, 0x00, 0x00, 0x00, 0x00, 0x00, 0x00, 0x00, 0x00, 0x00, 0x00, 0x00,
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  0x00, 0x00, 0x1f, 0xff, 0x00, 0x00, 0x1f, 0xff
};
// '2', 32x114px
const unsigned char epd_bitmap_2[] PROGMEM = {
  0x01, 0xff, 0xff, 0xfc, 0x01, 0xff, 0xff, 0xfc, 0x03, 0xff, 0xff, 0xfc, 0x03, 0xff, 0xff, 0xfc,
  0x03, 0xff, 0xff, 0xf8, 0x00, 0x00, 0x00, 0x00, 0x00, 0x00, 0x00, 0x00, 0x00, 0x00, 0x00, 0x00,
  0x00, 0x00, 0x00, 0x00, 0x00, 0x00, 0x00, 0x00, 0x00, 0x00, 0x00, 0x00, 0x00, 0x00, 0x00, 0x00,
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  0x3f, 0xff, 0xff, 0x80, 0x7f, 0xff, 0xff, 0x80
};
// '3', 32x114px
const unsigned char epd_bitmap_3[] PROGMEM = {
  0x01, 0xff, 0xff, 0xfc, 0x01, 0xff, 0xff, 0xfc, 0x03, 0xff, 0xff, 0xfc, 0x03, 0xff, 0xff, 0xf8,
  0x03, 0xff, 0xff, 0xf8, 0x00, 0x00, 0x00, 0x00, 0x00, 0x00, 0x00, 0x00, 0x00, 0x00, 0x00, 0x00,
  0x00, 0x00, 0x00, 0x00, 0x00, 0x00, 0x00, 0x00, 0x00, 0x00, 0x00, 0x00, 0x00, 0x00, 0x00, 0x00,
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  0x7f, 0xff, 0xff, 0x80, 0xff, 0xff, 0xff, 0x80
};
// '4', 32x114px
const unsigned char epd_bitmap_4[] PROGMEM = {
  0x00, 0x00, 0x00, 0xff, 0x01, 0x00, 0x00, 0xff, 0x01, 0x00, 0x00, 0xff, 0x01, 0x00, 0x00, 0xff,
  0x01, 0x00, 0x00, 0xff, 0x00, 0x00, 0x00, 0x00, 0x00, 0x00, 0x00, 0x00, 0x00, 0x00, 0x00, 0x00,
  0x00, 0x00, 0x00, 0x00, 0x00, 0x00, 0x00, 0x00, 0x00, 0x00, 0x00, 0x00, 0x00, 0x00, 0x00, 0x00,
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  0x00, 0x00, 0x00, 0xff, 0x00, 0x00, 0x00, 0xff
};
// '5', 32x114px
const unsigned char epd_bitmap_5[] PROGMEM = {
  0xff, 0xff, 0xff, 0xff, 0xff, 0xff, 0xff, 0xff, 0xff, 0xff, 0xff, 0xfe, 0xff, 0xff, 0xff, 0xfe,
  0xff, 0xff, 0xff, 0xfe, 0x00, 0x00, 0x00, 0x00, 0x00, 0x00, 0x00, 0x00, 0x00, 0x00, 0x00, 0x00,
  0x00, 0x00, 0x00, 0x00, 0x00, 0x00, 0x00, 0x00, 0x00, 0x00, 0x00, 0x00, 0x00, 0x00, 0x00, 0x00,
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  0xff, 0xff, 0xff, 0xfc, 0xff, 0xff, 0xff, 0xfc
};
// '6', 32x114px
const unsigned char epd_bitmap_6[] PROGMEM = {
  0x01, 0xff, 0xff, 0xff, 0x01, 0xff, 0xff, 0xff, 0x03, 0xff, 0xff, 0xfe, 0x03, 0xff, 0xff, 0xfe,
  0x03, 0xff, 0xff, 0xfe, 0x00, 0x00, 0x00, 0x00, 0x00, 0x00, 0x00, 0x00, 0x00, 0x00, 0x00, 0x00,
  0x00, 0x00, 0x00, 0x00, 0x00, 0x00, 0x00, 0x00, 0x00, 0x00, 0x00, 0x00, 0x00, 0x00, 0x00, 0x00,
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  0x3f, 0xff, 0xff, 0x80, 0x7f, 0xff, 0xff, 0x80
};
// '7', 32x114px
const unsigned char epd_bitmap_7[] PROGMEM = {
  0x01, 0xff, 0xff, 0xfc, 0x01, 0xff, 0xff, 0xfc, 0x03, 0xff, 0xff, 0xfc, 0x03, 0xff, 0xff, 0xf8,
  0x03, 0xff, 0xff, 0xf8, 0x00, 0x00, 0x00, 0x00, 0x00, 0x00, 0x00, 0x00, 0x00, 0x00, 0x00, 0x00,
  0x00, 0x00, 0x00, 0x00, 0x00, 0x00, 0x00, 0x00, 0x00, 0x00, 0x00, 0x00, 0x00, 0x00, 0x00, 0x00,
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  0x01, 0xff, 0x00, 0x00, 0x00, 0xfe, 0x00, 0x00
};
// '8', 32x114px
const unsigned char epd_bitmap_8[] PROGMEM = {
  0x01, 0xff, 0xff, 0xfc, 0x01, 0xff, 0xff, 0xfc, 0x01, 0xff, 0xff, 0xfc, 0x03, 0xff, 0xff, 0xfc,
  0x03, 0xff, 0xff, 0xf8, 0x00, 0x00, 0x00, 0x00, 0x00, 0x00, 0x00, 0x00, 0x00, 0x00, 0x00, 0x00,
  0x00, 0x00, 0x00, 0x00, 0x00, 0x00, 0x00, 0x00, 0x00, 0x00, 0x00, 0x00, 0x00, 0x00, 0x00, 0x00,
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  0x3f, 0xff, 0xff, 0x80, 0x3f, 0xff, 0xff, 0x80
};
// '9', 32x114px
const unsigned char epd_bitmap_9[] PROGMEM = {
  0x01, 0xff, 0xff, 0xfc, 0x01, 0xff, 0xff, 0xfc, 0x01, 0xff, 0xff, 0xfc, 0x03, 0xff, 0xff, 0xfc,
  0x03, 0xff, 0xff, 0xf8, 0x00, 0x00, 0x00, 0x00, 0x00, 0x00, 0x00, 0x00, 0x00, 0x00, 0x00, 0x00,
  0x00, 0x00, 0x00, 0x00, 0x00, 0x00, 0x00, 0x00, 0x00, 0x00, 0x00, 0x00, 0x00, 0x00, 0x00, 0x00,
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  0x7f, 0xff, 0xff, 0x80, 0x7f, 0xff, 0xff, 0x80
};

// Array of all bitmaps for convenience. (Total bytes used to store images in PROGMEM = 4800)
const int epd_bitmap_allArray_LEN = 10;
const unsigned char* epd_bitmap_allArray[10] = {
  epd_bitmap_0,
  epd_bitmap_1,
  epd_bitmap_2,
  epd_bitmap_3,
  epd_bitmap_4,
  epd_bitmap_5,
  epd_bitmap_6,
  epd_bitmap_7,
  epd_bitmap_8,
  epd_bitmap_9
};


void setup() {

  Serial.begin(115200);
  Wire.begin();



  TCA9548A(1);

  if (!rtc.begin()) {
    Serial.println("Couldn't find RTC");
    while (1)
      ;
  }
  if (rtc.lostPower()) {
    Serial.println("RTC lost power, setting the time!");
    // This line sets the RTC to the date & time this sketch was compiled
    rtc.adjust(DateTime(F(__DATE__), F(__TIME__)));
  }

  // Initialize all OLED displays
  for (int i = 2; i <= 7; i++) {
    TCA9548A(i);
    if (!display.begin(SSD1306_SWITCHCAPVCC, 0x3C)) {
      Serial.print("Display ");
      Serial.print(i);
      Serial.println(" initialization failed");
      for (;;)
        ;  // Don't proceed further
    }
    display.clearDisplay();
    //}


    //set display dim on startup
    display.dim(1);
    //delay(2000);
    display.setRotation(1);
  }
  //delay(200000);
}  //

void displayDigit(int displayNumber, int digit) {
  TCA9548A(displayNumber);
  display.drawBitmap(0, 0, epd_bitmap_allArray[digit], 32, 114, WHITE);
  display.display();
}


void loop() {

  TCA9548A(1);
  DateTime now = rtc.now();
  float tempC = rtc.getTemperature();
  float roundedTemp = round(tempC * 10) / 10.0;

  // Prepare the time string (HHMMSS)
  char timeStr[7];


  // Determine the part of the day
  const char* partOfDay;

  int hour = now.hour();
  int minute = now.minute();
  int second = now.second();
  if (hour >= 5 && hour < 12) {
    partOfDay = "Monin";
  } else if (hour >= 12 && hour < 17) {
    partOfDay = "Noon";
  } else if (hour >= 17 && hour < 21) {
    partOfDay = "Evnin";
  } else {
    partOfDay = "Night";
  }

  for (int i = 2; i <= 7; i++) {
    TCA9548A(i);
    display.clearDisplay();

    // Display additional info at the bottom
    display.setTextSize(1);  // Small font for additional info
    display.setTextColor(SSD1306_WHITE);
    display.setCursor(0,120);
    char additionalStr[15];  // Increased size for longer strings
    if (i == 2) {
      displayDigit(i, hour / 10);  // Day of the week
      display.println(Week_days[now.dayOfTheWeek()]);
    } else if (i == 3) {
      displayDigit(i, hour % 10);  // Part of the day
      display.println(partOfDay);
    } else if (i == 4) {
      displayDigit(i, minute / 10);  // "Temp ="
      display.println("Temp:");
    } else if (i == 5) {
      displayDigit(i, minute % 10);  // Temperature
      display.println(String(roundedTemp)+"c");
    } else if (i == 6) {
      displayDigit(i, second / 10);  // Date
      display.println("D: "+String(now.day()));
    } else if (i == 7) {
      displayDigit(i, second % 10);  // Month
      display.println("M: "+String(now.month()));
    }

    display.display();
  }

  //delay(1000);  // Update every second
}
